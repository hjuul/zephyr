## CMakeLists.txt
```
# SPDX-License-Identifier: Apache-2.0

cmake_minimum_required(VERSION 3.20.0)

find_package(Zephyr REQUIRED HINTS $ENV{ZEPHYR_BASE})
project(code_relocation)

FILE(GLOB app_sources src/*.c)
target_sources(app PRIVATE ${app_sources})

# Code relocation feature
#zephyr_code_relocate(src/test_file1.c SRAM2)
zephyr_code_relocate(src/test_file1.c SDRAM1_DATA_BSS)

zephyr_code_relocate(src/test_file2.c SRAM)

zephyr_code_relocate(src/test_file3.c SRAM2_TEXT)
zephyr_code_relocate(src/test_file3.c SRAM_DATA)
zephyr_code_relocate(src/test_file3.c SRAM2_BSS)

zephyr_code_relocate(../../../kernel/sem.c SRAM)

zephyr_linker_sources(SECTIONS custom-sections.ld)
```

## prj.conf
```kconfig
CONFIG_CODE_DATA_RELOCATION=y
CONFIG_HAVE_CUSTOM_LINKER_SCRIPT=y
CONFIG_CUSTOM_LINKER_SCRIPT="linker_arm_sram2.ld"
CONFIG_COVERAGE=n
CONFIG_MEMC=y
```

## src/test_file1.c
```c
/*
 * Copyright (c) 2012-2014 Wind River Systems, Inc.
 *
 * SPDX-License-Identifier: Apache-2.0
 */

#include <zephyr.h>
#include <sys/printk.h>

uint32_t var_sdram_data = 10U;
uint32_t var_sdram_bss;
K_SEM_DEFINE(test, 0, 1);
const uint32_t var_sdram_rodata = 100U;

__in_section(custom_section, static, var) uint32_t var_custom_data = 1U;

extern void function_in_sram(int32_t value);
void function_in_custom_section(void);
void function_in_sram2(void)
{


	/* Print values from sram2 */
	printk("Address of function_in_sram2 %p\n", &function_in_sram2);
	printk("Address of var_sdram_data %p\n", &var_sdram_data);
	printk("Address of k_sem_give %p\n", &k_sem_give);
	printk("Address of var_sdram_rodata %p\n", &var_sdram_rodata);
	printk("Address of var_sdram_bss %p\n\n", &var_sdram_bss);

	/* Print values from sram */
	function_in_sram(var_sdram_data);

	printk("\n\n");
	printk("***** var_sdram_data=%d, expected 10\n", var_sdram_data);
	printk("***** var_sdram_bss=%d, expected 0\n", var_sdram_bss);
	printk("\n\n");

	/* Print values which were placed using attributes */
	printk("Address of custom_section, func placed using attributes %p\n",
	       &function_in_custom_section);
	printk("Address of custom_section data placed using attributes %p\n\n",
	       &var_custom_data);

	k_sem_give(&test);
}

__in_section(custom_section, static, fun) void function_in_custom_section(void)
{
	return;

}
```
